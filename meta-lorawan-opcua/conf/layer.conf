## meta-lorawan-opcua/conf/layer.conf
```bitbake
# meta-lorawan-opcua
#
# Custom Yocto layer for the LoRaWAN OPC UA Mapper project.
#
# Supported Release:
#   - Yocto Scarthgap
#
# Maintainer:
#   Bardiya Aghsami
#

# Layer search path

BBPATH .= ":${LAYERDIR}"

# Recipe search path

BBFILES += "\
    ${LAYERDIR}/recipes-*/*/*.bb \
    ${LAYERDIR}/recipes-*/*/*.bbappend \
"

# Layer registration

BBFILE_COLLECTIONS += "meta-lorawan-opcua"

BBFILE_PATTERN_meta-lorawan-opcua = "^${LAYERDIR}/"

BBFILE_PRIORITY_meta-lorawan-opcua = "6"

# Dependencies

LAYERDEPENDS_meta-lorawan-opcua = "core"

# Compatible Yocto releases

LAYERSERIES_COMPAT_meta-lorawan-opcua = "scarthgap"
```
